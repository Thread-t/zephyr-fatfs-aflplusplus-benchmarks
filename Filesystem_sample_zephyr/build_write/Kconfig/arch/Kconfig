## Filesystem_sample_zephyr/build_write/Kconfig/soc/Kconfig.soc
```kconfig
# Load SoC Kconfig descriptions.
osource "/home/cheri/CHERI-zephyr/soc/xlnx/zynqmp/Kconfig.soc"
osource "/home/cheri/CHERI-zephyr/soc/xlnx/zynq7000/Kconfig.soc"
osource "/home/cheri/CHERI-zephyr/soc/xlnx/versalnet/Kconfig.soc"
osource "/home/cheri/CHERI-zephyr/soc/xlnx/versal2/Kconfig.soc"
osource "/home/cheri/CHERI-zephyr/soc/xen/Kconfig.soc"
osource "/home/cheri/CHERI-zephyr/soc/wch/ch32v/Kconfig.soc"
osource "/home/cheri/CHERI-zephyr/soc/ti/simplelink/Kconfig.soc"
osource "/home/cheri/CHERI-zephyr/soc/ti/lm3s6965/Kconfig.soc"
osource "/home/cheri/CHERI-zephyr/soc/ti/k3/Kconfig.soc"
osource "/home/cheri/CHERI-zephyr/soc/telink/tlsr/Kconfig.soc"
osource "/home/cheri/CHERI-zephyr/soc/starfive/jh71xx/Kconfig.soc"
osource "/home/cheri/CHERI-zephyr/soc/st/stm32/Kconfig.soc"
osource "/home/cheri/CHERI-zephyr/soc/snps/qemu_arc/Kconfig.soc"
osource "/home/cheri/CHERI-zephyr/soc/snps/nsim/arc_v/Kconfig.soc"
osource "/home/cheri/CHERI-zephyr/soc/snps/nsim/arc_classic/Kconfig.soc"
osource "/home/cheri/CHERI-zephyr/soc/snps/hsdk4xd/Kconfig.soc"
osource "/home/cheri/CHERI-zephyr/soc/snps/hsdk/Kconfig.soc"
osource "/home/cheri/CHERI-zephyr/soc/snps/emsk/Kconfig.soc"
osource "/home/cheri/CHERI-zephyr/soc/snps/emsdp/Kconfig.soc"
osource "/home/cheri/CHERI-zephyr/soc/snps/arc_iot/Kconfig.soc"
osource "/home/cheri/CHERI-zephyr/soc/silabs/Kconfig.soc"
osource "/home/cheri/CHERI-zephyr/soc/sifive/sifive_freedom/Kconfig.soc"
osource "/home/cheri/CHERI-zephyr/soc/sensry/Kconfig.soc"
osource "/home/cheri/CHERI-zephyr/soc/rockchip/Kconfig.soc"
osource "/home/cheri/CHERI-zephyr/soc/renode/riscv_virtual/Kconfig.soc"
osource "/home/cheri/CHERI-zephyr/soc/renode/cortex_r8_virtual/Kconfig.soc"
osource "/home/cheri/CHERI-zephyr/soc/renesas/smartbond/Kconfig.soc"
osource "/home/cheri/CHERI-zephyr/soc/renesas/rz/Kconfig.soc"
osource "/home/cheri/CHERI-zephyr/soc/renesas/rx/Kconfig.soc"
osource "/home/cheri/CHERI-zephyr/soc/renesas/rcar/Kconfig.soc"
osource "/home/cheri/CHERI-zephyr/soc/renesas/ra/Kconfig.soc"
osource "/home/cheri/CHERI-zephyr/soc/realtek/ec/Kconfig.soc"
osource "/home/cheri/CHERI-zephyr/soc/raspberrypi/rpi_pico/Kconfig.soc"
osource "/home/cheri/CHERI-zephyr/soc/quicklogic/eos_s3/Kconfig.soc"
osource "/home/cheri/CHERI-zephyr/soc/qemu/virt_riscv/Kconfig.soc"
osource "/home/cheri/CHERI-zephyr/soc/qemu/malta/Kconfig.soc"
osource "/home/cheri/CHERI-zephyr/soc/openisa/rv32m1/Kconfig.soc"
osource "/home/cheri/CHERI-zephyr/soc/openhwgroup/cva6/Kconfig.soc"
osource "/home/cheri/CHERI-zephyr/soc/oct/osd32mp15x/Kconfig.soc"
osource "/home/cheri/CHERI-zephyr/soc/nxp/s32/Kconfig.soc"
osource "/home/cheri/CHERI-zephyr/soc/nxp/rw/Kconfig.soc"
osource "/home/cheri/CHERI-zephyr/soc/nxp/mcx/Kconfig.soc"
osource "/home/cheri/CHERI-zephyr/soc/nxp/lpc/Kconfig.soc"
osource "/home/cheri/CHERI-zephyr/soc/nxp/layerscape/Kconfig.soc"
osource "/home/cheri/CHERI-zephyr/soc/nxp/kinetis/Kconfig.soc"
osource "/home/cheri/CHERI-zephyr/soc/nxp/imxrt/Kconfig.soc"
osource "/home/cheri/CHERI-zephyr/soc/nxp/imx/Kconfig.soc"
osource "/home/cheri/CHERI-zephyr/soc/nuvoton/numicro/Kconfig.soc"
osource "/home/cheri/CHERI-zephyr/soc/nuvoton/numaker/Kconfig.soc"
osource "/home/cheri/CHERI-zephyr/soc/nuvoton/npcx/Kconfig.soc"
osource "/home/cheri/CHERI-zephyr/soc/nuvoton/npcm/Kconfig.soc"
osource "/home/cheri/CHERI-zephyr/soc/nordic/Kconfig.soc"
osource "/home/cheri/CHERI-zephyr/soc/neorv32/Kconfig.soc"
osource "/home/cheri/CHERI-zephyr/soc/native/inf_clock/Kconfig.soc"
osource "/home/cheri/CHERI-zephyr/soc/microchip/miv/Kconfig.soc"
osource "/home/cheri/CHERI-zephyr/soc/microchip/mec/Kconfig.soc"
osource "/home/cheri/CHERI-zephyr/soc/mediatek/mt8xxx/Kconfig.soc"
osource "/home/cheri/CHERI-zephyr/soc/lowrisc/opentitan/Kconfig.soc"
osource "/home/cheri/CHERI-zephyr/soc/litex/litex_vexriscv/Kconfig.soc"
osource "/home/cheri/CHERI-zephyr/soc/ite/ec/Kconfig.soc"
osource "/home/cheri/CHERI-zephyr/soc/intel/raptor_lake/Kconfig.soc"
osource "/home/cheri/CHERI-zephyr/soc/intel/lakemont/Kconfig.soc"
osource "/home/cheri/CHERI-zephyr/soc/intel/intel_socfpga_std/Kconfig.soc"
osource "/home/cheri/CHERI-zephyr/soc/intel/intel_socfpga/Kconfig.soc"
osource "/home/cheri/CHERI-zephyr/soc/intel/intel_niosv/Kconfig.soc"
osource "/home/cheri/CHERI-zephyr/soc/intel/intel_ish/Kconfig.soc"
osource "/home/cheri/CHERI-zephyr/soc/intel/intel_adsp/Kconfig.soc"
osource "/home/cheri/CHERI-zephyr/soc/intel/elkhart_lake/Kconfig.soc"
osource "/home/cheri/CHERI-zephyr/soc/intel/atom/Kconfig.soc"
osource "/home/cheri/CHERI-zephyr/soc/intel/apollo_lake/Kconfig.soc"
osource "/home/cheri/CHERI-zephyr/soc/intel/alder_lake/Kconfig.soc"
osource "/home/cheri/CHERI-zephyr/soc/infineon/cat3/Kconfig.soc"
osource "/home/cheri/CHERI-zephyr/soc/infineon/cat1b/Kconfig.soc"
osource "/home/cheri/CHERI-zephyr/soc/infineon/cat1a/Kconfig.soc"
osource "/home/cheri/CHERI-zephyr/soc/gd/gd32/Kconfig.soc"
osource "/home/cheri/CHERI-zephyr/soc/gaisler/leon3/Kconfig.soc"
osource "/home/cheri/CHERI-zephyr/soc/gaisler/gr716a/Kconfig.soc"
osource "/home/cheri/CHERI-zephyr/soc/espressif/Kconfig.soc"
osource "/home/cheri/CHERI-zephyr/soc/ene/kb1200/Kconfig.soc"
osource "/home/cheri/CHERI-zephyr/soc/efinix/sapphire/Kconfig.soc"
osource "/home/cheri/CHERI-zephyr/soc/cdns/xtensa_sample_controller/Kconfig.soc"
osource "/home/cheri/CHERI-zephyr/soc/cdns/sample_controller32/Kconfig.soc"
osource "/home/cheri/CHERI-zephyr/soc/cdns/dc233c/Kconfig.soc"
osource "/home/cheri/CHERI-zephyr/soc/brcm/bcmvk/Kconfig.soc"
osource "/home/cheri/CHERI-zephyr/soc/brcm/bcm2712/Kconfig.soc"
osource "/home/cheri/CHERI-zephyr/soc/brcm/bcm2711/Kconfig.soc"
osource "/home/cheri/CHERI-zephyr/soc/bflb/Kconfig.soc"
osource "/home/cheri/CHERI-zephyr/soc/atmel/sam0/Kconfig.soc"
osource "/home/cheri/CHERI-zephyr/soc/atmel/sam/Kconfig.soc"
osource "/home/cheri/CHERI-zephyr/soc/aspeed/Kconfig.soc"
osource "/home/cheri/CHERI-zephyr/soc/arm/Kconfig.soc"
osource "/home/cheri/CHERI-zephyr/soc/arm/beetle/Kconfig.soc"
osource "/home/cheri/CHERI-zephyr/soc/antmicro/myra/Kconfig.soc"
osource "/home/cheri/CHERI-zephyr/soc/andestech/Kconfig.soc"
osource "/home/cheri/CHERI-zephyr/soc/amd/acp_6_0/Kconfig.soc"
osource "/home/cheri/CHERI-zephyr/soc/ambiq/Kconfig.soc"
osource "/home/cheri/CHERI-zephyr/soc/aesc/Kconfig.soc"
osource "/home/cheri/CHERI-zephyr/soc/adi/max32/Kconfig.soc"
```

## Filesystem_sample_zephyr/build_write/Kconfig/soc/Kconfig.sysbuild
```kconfig
# Load Sysbuild SoC Kconfig descriptions.
osource "/home/cheri/CHERI-zephyr/soc/xlnx/zynqmp/Kconfig.sysbuild"
osource "/home/cheri/CHERI-zephyr/soc/xlnx/zynq7000/Kconfig.sysbuild"
osource "/home/cheri/CHERI-zephyr/soc/xlnx/versalnet/Kconfig.sysbuild"
osource "/home/cheri/CHERI-zephyr/soc/xlnx/versal2/Kconfig.sysbuild"
osource "/home/cheri/CHERI-zephyr/soc/xen/Kconfig.sysbuild"
osource "/home/cheri/CHERI-zephyr/soc/wch/ch32v/Kconfig.sysbuild"
osource "/home/cheri/CHERI-zephyr/soc/ti/simplelink/Kconfig.sysbuild"
osource "/home/cheri/CHERI-zephyr/soc/ti/lm3s6965/Kconfig.sysbuild"
osource "/home/cheri/CHERI-zephyr/soc/ti/k3/Kconfig.sysbuild"
osource "/home/cheri/CHERI-zephyr/soc/telink/tlsr/Kconfig.sysbuild"
osource "/home/cheri/CHERI-zephyr/soc/starfive/jh71xx/Kconfig.sysbuild"
osource "/home/cheri/CHERI-zephyr/soc/st/stm32/Kconfig.sysbuild"
osource "/home/cheri/CHERI-zephyr/soc/snps/qemu_arc/Kconfig.sysbuild"
osource "/home/cheri/CHERI-zephyr/soc/snps/nsim/arc_v/Kconfig.sysbuild"
osource "/home/cheri/CHERI-zephyr/soc/snps/nsim/arc_classic/Kconfig.sysbuild"
osource "/home/cheri/CHERI-zephyr/soc/snps/hsdk4xd/Kconfig.sysbuild"
osource "/home/cheri/CHERI-zephyr/soc/snps/hsdk/Kconfig.sysbuild"
osource "/home/cheri/CHERI-zephyr/soc/snps/emsk/Kconfig.sysbuild"
osource "/home/cheri/CHERI-zephyr/soc/snps/emsdp/Kconfig.sysbuild"
osource "/home/cheri/CHERI-zephyr/soc/snps/arc_iot/Kconfig.sysbuild"
osource "/home/cheri/CHERI-zephyr/soc/silabs/Kconfig.sysbuild"
osource "/home/cheri/CHERI-zephyr/soc/sifive/sifive_freedom/Kconfig.sysbuild"
osource "/home/cheri/CHERI-zephyr/soc/sensry/Kconfig.sysbuild"
osource "/home/cheri/CHERI-zephyr/soc/rockchip/Kconfig.sysbuild"
osource "/home/cheri/CHERI-zephyr/soc/renode/riscv_virtual/Kconfig.sysbuild"
osource "/home/cheri/CHERI-zephyr/soc/renode/cortex_r8_virtual/Kconfig.sysbuild"
osource "/home/cheri/CHERI-zephyr/soc/renesas/smartbond/Kconfig.sysbuild"
osource "/home/cheri/CHERI-zephyr/soc/renesas/rz/Kconfig.sysbuild"
osource "/home/cheri/CHERI-zephyr/soc/renesas/rx/Kconfig.sysbuild"
osource "/home/cheri/CHERI-zephyr/soc/renesas/rcar/Kconfig.sysbuild"
osource "/home/cheri/CHERI-zephyr/soc/renesas/ra/Kconfig.sysbuild"
osource "/home/cheri/CHERI-zephyr/soc/realtek/ec/Kconfig.sysbuild"
osource "/home/cheri/CHERI-zephyr/soc/raspberrypi/rpi_pico/Kconfig.sysbuild"
osource "/home/cheri/CHERI-zephyr/soc/quicklogic/eos_s3/Kconfig.sysbuild"
osource "/home/cheri/CHERI-zephyr/soc/qemu/virt_riscv/Kconfig.sysbuild"
osource "/home/cheri/CHERI-zephyr/soc/qemu/malta/Kconfig.sysbuild"
osource "/home/cheri/CHERI-zephyr/soc/openisa/rv32m1/Kconfig.sysbuild"
osource "/home/cheri/CHERI-zephyr/soc/openhwgroup/cva6/Kconfig.sysbuild"
osource "/home/cheri/CHERI-zephyr/soc/oct/osd32mp15x/Kconfig.sysbuild"
osource "/home/cheri/CHERI-zephyr/soc/nxp/s32/Kconfig.sysbuild"
osource "/home/cheri/CHERI-zephyr/soc/nxp/rw/Kconfig.sysbuild"
osource "/home/cheri/CHERI-zephyr/soc/nxp/mcx/Kconfig.sysbuild"
osource "/home/cheri/CHERI-zephyr/soc/nxp/lpc/Kconfig.sysbuild"
osource "/home/cheri/CHERI-zephyr/soc/nxp/layerscape/Kconfig.sysbuild"
osource "/home/cheri/CHERI-zephyr/soc/nxp/kinetis/Kconfig.sysbuild"
osource "/home/cheri/CHERI-zephyr/soc/nxp/imxrt/Kconfig.sysbuild"
osource "/home/cheri/CHERI-zephyr/soc/nxp/imx/Kconfig.sysbuild"
osource "/home/cheri/CHERI-zephyr/soc/nuvoton/numicro/Kconfig.sysbuild"
osource "/home/cheri/CHERI-zephyr/soc/nuvoton/numaker/Kconfig.sysbuild"
osource "/home/cheri/CHERI-zephyr/soc/nuvoton/npcx/Kconfig.sysbuild"
osource "/home/cheri/CHERI-zephyr/soc/nuvoton/npcm/Kconfig.sysbuild"
osource "/home/cheri/CHERI-zephyr/soc/nordic/Kconfig.sysbuild"
osource "/home/cheri/CHERI-zephyr/soc/neorv32/Kconfig.sysbuild"
osource "/home/cheri/CHERI-zephyr/soc/native/inf_clock/Kconfig.sysbuild"
osource "/home/cheri/CHERI-zephyr/soc/microchip/miv/Kconfig.sysbuild"
osource "/home/cheri/CHERI-zephyr/soc/microchip/mec/Kconfig.sysbuild"
osource "/home/cheri/CHERI-zephyr/soc/mediatek/mt8xxx/Kconfig.sysbuild"
osource "/home/cheri/CHERI-zephyr/soc/lowrisc/opentitan/Kconfig.sysbuild"
osource "/home/cheri/CHERI-zephyr/soc/litex/litex_vexriscv/Kconfig.sysbuild"
osource "/home/cheri/CHERI-zephyr/soc/ite/ec/Kconfig.sysbuild"
osource "/home/cheri/CHERI-zephyr/soc/intel/raptor_lake/Kconfig.sysbuild"
osource "/home/cheri/CHERI-zephyr/soc/intel/lakemont/Kconfig.sysbuild"
osource "/home/cheri/CHERI-zephyr/soc/intel/intel_socfpga_std/Kconfig.sysbuild"
osource "/home/cheri/CHERI-zephyr/soc/intel/intel_socfpga/Kconfig.sysbuild"
osource "/home/cheri/CHERI-zephyr/soc/intel/intel_niosv/Kconfig.sysbuild"
osource "/home/cheri/CHERI-zephyr/soc/intel/intel_ish/Kconfig.sysbuild"
osource "/home/cheri/CHERI-zephyr/soc/intel/intel_adsp/Kconfig.sysbuild"
osource "/home/cheri/CHERI-zephyr/soc/intel/elkhart_lake/Kconfig.sysbuild"
osource "/home/cheri/CHERI-zephyr/soc/intel/atom/Kconfig.sysbuild"
osource "/home/cheri/CHERI-zephyr/soc/intel/apollo_lake/Kconfig.sysbuild"
osource "/home/cheri/CHERI-zephyr/soc/intel/alder_lake/Kconfig.sysbuild"
osource "/home/cheri/CHERI-zephyr/soc/infineon/cat3/Kconfig.sysbuild"
osource "/home/cheri/CHERI-zephyr/soc/infineon/cat1b/Kconfig.sysbuild"
osource "/home/cheri/CHERI-zephyr/soc/infineon/cat1a/Kconfig.sysbuild"
osource "/home/cheri/CHERI-zephyr/soc/gd/gd32/Kconfig.sysbuild"
osource "/home/cheri/CHERI-zephyr/soc/gaisler/leon3/Kconfig.sysbuild"
osource "/home/cheri/CHERI-zephyr/soc/gaisler/gr716a/Kconfig.sysbuild"
osource "/home/cheri/CHERI-zephyr/soc/espressif/Kconfig.sysbuild"
osource "/home/cheri/CHERI-zephyr/soc/ene/kb1200/Kconfig.sysbuild"
osource "/home/cheri/CHERI-zephyr/soc/efinix/sapphire/Kconfig.sysbuild"
osource "/home/cheri/CHERI-zephyr/soc/cdns/xtensa_sample_controller/Kconfig.sysbuild"
osource "/home/cheri/CHERI-zephyr/soc/cdns/sample_controller32/Kconfig.sysbuild"
osource "/home/cheri/CHERI-zephyr/soc/cdns/dc233c/Kconfig.sysbuild"
osource "/home/cheri/CHERI-zephyr/soc/brcm/bcmvk/Kconfig.sysbuild"
osource "/home/cheri/CHERI-zephyr/soc/brcm/bcm2712/Kconfig.sysbuild"
osource "/home/cheri/CHERI-zephyr/soc/brcm/bcm2711/Kconfig.sysbuild"
osource "/home/cheri/CHERI-zephyr/soc/bflb/Kconfig.sysbuild"
osource "/home/cheri/CHERI-zephyr/soc/atmel/sam0/Kconfig.sysbuild"
osource "/home/cheri/CHERI-zephyr/soc/atmel/sam/Kconfig.sysbuild"
osource "/home/cheri/CHERI-zephyr/soc/aspeed/Kconfig.sysbuild"
osource "/home/cheri/CHERI-zephyr/soc/arm/Kconfig.sysbuild"
osource "/home/cheri/CHERI-zephyr/soc/arm/beetle/Kconfig.sysbuild"
osource "/home/cheri/CHERI-zephyr/soc/antmicro/myra/Kconfig.sysbuild"
osource "/home/cheri/CHERI-zephyr/soc/andestech/Kconfig.sysbuild"
osource "/home/cheri/CHERI-zephyr/soc/amd/acp_6_0/Kconfig.sysbuild"
osource "/home/cheri/CHERI-zephyr/soc/ambiq/Kconfig.sysbuild"
osource "/home/cheri/CHERI-zephyr/soc/aesc/Kconfig.sysbuild"
osource "/home/cheri/CHERI-zephyr/soc/adi/max32/Kconfig.sysbuild"
```
