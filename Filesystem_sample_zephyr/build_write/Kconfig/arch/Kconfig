## Filesystem_sample_zephyr/build_write/Kconfig/arch/Kconfig
```kconfig
# Load Zephyr Arch Kconfig descriptions.
osource "/home/cheri/CHERI-zephyr/arch/rx/Kconfig"
osource "/home/cheri/CHERI-zephyr/arch/x86/Kconfig"
osource "/home/cheri/CHERI-zephyr/arch/xtensa/Kconfig"
osource "/home/cheri/CHERI-zephyr/arch/sparc/Kconfig"
osource "/home/cheri/CHERI-zephyr/arch/riscv/Kconfig"
osource "/home/cheri/CHERI-zephyr/arch/posix/Kconfig"
osource "/home/cheri/CHERI-zephyr/arch/mips/Kconfig"
osource "/home/cheri/CHERI-zephyr/arch/arm64/Kconfig"
osource "/home/cheri/CHERI-zephyr/arch/arm/Kconfig"
osource "/home/cheri/CHERI-zephyr/arch/arc/Kconfig"
```

## Filesystem_sample_zephyr/build_write/Kconfig/boards/Kconfig
```kconfig
# Load Zephyr board Kconfig descriptions.
osource "/home/cheri/CHERI-zephyr/boards/qemu/riscv32cheri/Kconfig"
```

## Filesystem_sample_zephyr/build_write/Kconfig/boards/Kconfig.defconfig
```kconfig
# Load Zephyr board defconfig descriptions.
osource "/home/cheri/CHERI-zephyr/boards/qemu/riscv32cheri/Kconfig.defconfig"
```

## Filesystem_sample_zephyr/build_write/Kconfig/boards/Kconfig.qemu_riscv32cheri_purecap
```kconfig
# Load board Kconfig descriptions.
osource "/home/cheri/CHERI-zephyr/boards/qemu/riscv32cheri/Kconfig.qemu_riscv32cheri_purecap"
```

## Filesystem_sample_zephyr/build_write/Kconfig/boards/Kconfig.sysbuild
```kconfig
# Load Sysbuild board Kconfig descriptions.
osource "/home/cheri/CHERI-zephyr/boards/qemu/riscv32cheri/Kconfig.sysbuild"
```

## Filesystem_sample_zephyr/build_write/Kconfig/soc/Kconfig
```kconfig
# Load Zephyr SoC Kconfig descriptions.
osource "/home/cheri/CHERI-zephyr/soc/xlnx/zynqmp/Kconfig"
osource "/home/cheri/CHERI-zephyr/soc/xlnx/zynq7000/Kconfig"
osource "/home/cheri/CHERI-zephyr/soc/xlnx/versalnet/Kconfig"
osource "/home/cheri/CHERI-zephyr/soc/xlnx/versal2/Kconfig"
osource "/home/cheri/CHERI-zephyr/soc/xen/Kconfig"
osource "/home/cheri/CHERI-zephyr/soc/wch/ch32v/Kconfig"
osource "/home/cheri/CHERI-zephyr/soc/ti/simplelink/Kconfig"
osource "/home/cheri/CHERI-zephyr/soc/ti/lm3s6965/Kconfig"
osource "/home/cheri/CHERI-zephyr/soc/ti/k3/Kconfig"
osource "/home/cheri/CHERI-zephyr/soc/telink/tlsr/Kconfig"
osource "/home/cheri/CHERI-zephyr/soc/starfive/jh71xx/Kconfig"
osource "/home/cheri/CHERI-zephyr/soc/st/stm32/Kconfig"
osource "/home/cheri/CHERI-zephyr/soc/snps/qemu_arc/Kconfig"
osource "/home/cheri/CHERI-zephyr/soc/snps/nsim/arc_v/Kconfig"
osource "/home/cheri/CHERI-zephyr/soc/snps/nsim/arc_classic/Kconfig"
osource "/home/cheri/CHERI-zephyr/soc/snps/hsdk4xd/Kconfig"
osource "/home/cheri/CHERI-zephyr/soc/snps/hsdk/Kconfig"
osource "/home/cheri/CHERI-zephyr/soc/snps/emsk/Kconfig"
osource "/home/cheri/CHERI-zephyr/soc/snps/emsdp/Kconfig"
osource "/home/cheri/CHERI-zephyr/soc/snps/arc_iot/Kconfig"
osource "/home/cheri/CHERI-zephyr/soc/silabs/Kconfig"
osource "/home/cheri/CHERI-zephyr/soc/sifive/sifive_freedom/Kconfig"
osource "/home/cheri/CHERI-zephyr/soc/sensry/Kconfig"
osource "/home/cheri/CHERI-zephyr/soc/rockchip/Kconfig"
osource "/home/cheri/CHERI-zephyr/soc/renode/riscv_virtual/Kconfig"
osource "/home/cheri/CHERI-zephyr/soc/renode/cortex_r8_virtual/Kconfig"
osource "/home/cheri/CHERI-zephyr/soc/renesas/smartbond/Kconfig"
osource "/home/cheri/CHERI-zephyr/soc/renesas/rz/Kconfig"
osource "/home/cheri/CHERI-zephyr/soc/renesas/rx/Kconfig"
osource "/home/cheri/CHERI-zephyr/soc/renesas/rcar/Kconfig"
osource "/home/cheri/CHERI-zephyr/soc/renesas/ra/Kconfig"
osource "/home/cheri/CHERI-zephyr/soc/realtek/ec/Kconfig"
osource "/home/cheri/CHERI-zephyr/soc/raspberrypi/rpi_pico/Kconfig"
osource "/home/cheri/CHERI-zephyr/soc/quicklogic/eos_s3/Kconfig"
osource "/home/cheri/CHERI-zephyr/soc/qemu/virt_riscv/Kconfig"
osource "/home/cheri/CHERI-zephyr/soc/qemu/malta/Kconfig"
osource "/home/cheri/CHERI-zephyr/soc/openisa/rv32m1/Kconfig"
osource "/home/cheri/CHERI-zephyr/soc/openhwgroup/cva6/Kconfig"
osource "/home/cheri/CHERI-zephyr/soc/oct/osd32mp15x/Kconfig"
osource "/home/cheri/CHERI-zephyr/soc/nxp/s32/Kconfig"
osource "/home/cheri/CHERI-zephyr/soc/nxp/rw/Kconfig"
osource "/home/cheri/CHERI-zephyr/soc/nxp/mcx/Kconfig"
osource "/home/cheri/CHERI-zephyr/soc/nxp/lpc/Kconfig"
osource "/home/cheri/CHERI-zephyr/soc/nxp/layerscape/Kconfig"
osource "/home/cheri/CHERI-zephyr/soc/nxp/kinetis/Kconfig"
osource "/home/cheri/CHERI-zephyr/soc/nxp/imxrt/Kconfig"
osource "/home/cheri/CHERI-zephyr/soc/nxp/imx/Kconfig"
osource "/home/cheri/CHERI-zephyr/soc/nuvoton/numicro/Kconfig"
osource "/home/cheri/CHERI-zephyr/soc/nuvoton/numaker/Kconfig"
osource "/home/cheri/CHERI-zephyr/soc/nuvoton/npcx/Kconfig"
osource "/home/cheri/CHERI-zephyr/soc/nuvoton/npcm/Kconfig"
osource "/home/cheri/CHERI-zephyr/soc/nordic/Kconfig"
osource "/home/cheri/CHERI-zephyr/soc/neorv32/Kconfig"
osource "/home/cheri/CHERI-zephyr/soc/native/inf_clock/Kconfig"
osource "/home/cheri/CHERI-zephyr/soc/microchip/miv/Kconfig"
osource "/home/cheri/CHERI-zephyr/soc/microchip/mec/Kconfig"
osource "/home/cheri/CHERI-zephyr/soc/mediatek/mt8xxx/Kconfig"
osource "/home/cheri/CHERI-zephyr/soc/lowrisc/opentitan/Kconfig"
osource "/home/cheri/CHERI-zephyr/soc/litex/litex_vexriscv/Kconfig"
osource "/home/cheri/CHERI-zephyr/soc/ite/ec/Kconfig"
osource "/home/cheri/CHERI-zephyr/soc/intel/raptor_lake/Kconfig"
osource "/home/cheri/CHERI-zephyr/soc/intel/lakemont/Kconfig"
osource "/home/cheri/CHERI-zephyr/soc/intel/intel_socfpga_std/Kconfig"
osource "/home/cheri/CHERI-zephyr/soc/intel/intel_socfpga/Kconfig"
osource "/home/cheri/CHERI-zephyr/soc/intel/intel_niosv/Kconfig"
osource "/home/cheri/CHERI-zephyr/soc/intel/intel_ish/Kconfig"
osource "/home/cheri/CHERI-zephyr/soc/intel/intel_adsp/Kconfig"
osource "/home/cheri/CHERI-zephyr/soc/intel/elkhart_lake/Kconfig"
osource "/home/cheri/CHERI-zephyr/soc/intel/atom/Kconfig"
osource "/home/cheri/CHERI-zephyr/soc/intel/apollo_lake/Kconfig"
osource "/home/cheri/CHERI-zephyr/soc/intel/alder_lake/Kconfig"
osource "/home/cheri/CHERI-zephyr/soc/infineon/cat3/Kconfig"
osource "/home/cheri/CHERI-zephyr/soc/infineon/cat1b/Kconfig"
osource "/home/cheri/CHERI-zephyr/soc/infineon/cat1a/Kconfig"
osource "/home/cheri/CHERI-zephyr/soc/gd/gd32/Kconfig"
osource "/home/cheri/CHERI-zephyr/soc/gaisler/leon3/Kconfig"
osource "/home/cheri/CHERI-zephyr/soc/gaisler/gr716a/Kconfig"
osource "/home/cheri/CHERI-zephyr/soc/espressif/Kconfig"
osource "/home/cheri/CHERI-zephyr/soc/ene/kb1200/Kconfig"
osource "/home/cheri/CHERI-zephyr/soc/efinix/sapphire/Kconfig"
osource "/home/cheri/CHERI-zephyr/soc/cdns/xtensa_sample_controller/Kconfig"
osource "/home/cheri/CHERI-zephyr/soc/cdns/sample_controller32/Kconfig"
osource "/home/cheri/CHERI-zephyr/soc/cdns/dc233c/Kconfig"
osource "/home/cheri/CHERI-zephyr/soc/brcm/bcmvk/Kconfig"
osource "/home/cheri/CHERI-zephyr/soc/brcm/bcm2712/Kconfig"
osource "/home/cheri/CHERI-zephyr/soc/brcm/bcm2711/Kconfig"
osource "/home/cheri/CHERI-zephyr/soc/bflb/Kconfig"
osource "/home/cheri/CHERI-zephyr/soc/atmel/sam0/Kconfig"
osource "/home/cheri/CHERI-zephyr/soc/atmel/sam/Kconfig"
osource "/home/cheri/CHERI-zephyr/soc/aspeed/Kconfig"
osource "/home/cheri/CHERI-zephyr/soc/arm/Kconfig"
osource "/home/cheri/CHERI-zephyr/soc/arm/beetle/Kconfig"
osource "/home/cheri/CHERI-zephyr/soc/antmicro/myra/Kconfig"
osource "/home/cheri/CHERI-zephyr/soc/andestech/Kconfig"
osource "/home/cheri/CHERI-zephyr/soc/amd/acp_6_0/Kconfig"
osource "/home/cheri/CHERI-zephyr/soc/ambiq/Kconfig"
osource "/home/cheri/CHERI-zephyr/soc/aesc/Kconfig"
osource "/home/cheri/CHERI-zephyr/soc/adi/max32/Kconfig"
```

## Filesystem_sample_zephyr/build_write/Kconfig/soc/Kconfig.defconfig
```kconfig
# Load Zephyr SoC defconfig descriptions.
osource "/home/cheri/CHERI-zephyr/soc/xlnx/zynqmp/Kconfig.defconfig"
osource "/home/cheri/CHERI-zephyr/soc/xlnx/zynq7000/Kconfig.defconfig"
osource "/home/cheri/CHERI-zephyr/soc/xlnx/versalnet/Kconfig.defconfig"
osource "/home/cheri/CHERI-zephyr/soc/xlnx/versal2/Kconfig.defconfig"
osource "/home/cheri/CHERI-zephyr/soc/xen/Kconfig.defconfig"
osource "/home/cheri/CHERI-zephyr/soc/wch/ch32v/Kconfig.defconfig"
osource "/home/cheri/CHERI-zephyr/soc/ti/simplelink/Kconfig.defconfig"
osource "/home/cheri/CHERI-zephyr/soc/ti/lm3s6965/Kconfig.defconfig"
osource "/home/cheri/CHERI-zephyr/soc/ti/k3/Kconfig.defconfig"
osource "/home/cheri/CHERI-zephyr/soc/telink/tlsr/Kconfig.defconfig"
osource "/home/cheri/CHERI-zephyr/soc/starfive/jh71xx/Kconfig.defconfig"
osource "/home/cheri/CHERI-zephyr/soc/st/stm32/Kconfig.defconfig"
osource "/home/cheri/CHERI-zephyr/soc/snps/qemu_arc/Kconfig.defconfig"
osource "/home/cheri/CHERI-zephyr/soc/snps/nsim/arc_v/Kconfig.defconfig"
osource "/home/cheri/CHERI-zephyr/soc/snps/nsim/arc_classic/Kconfig.defconfig"
osource "/home/cheri/CHERI-zephyr/soc/snps/hsdk4xd/Kconfig.defconfig"
osource "/home/cheri/CHERI-zephyr/soc/snps/hsdk/Kconfig.defconfig"
osource "/home/cheri/CHERI-zephyr/soc/snps/emsk/Kconfig.defconfig"
osource "/home/cheri/CHERI-zephyr/soc/snps/emsdp/Kconfig.defconfig"
osource "/home/cheri/CHERI-zephyr/soc/snps/arc_iot/Kconfig.defconfig"
osource "/home/cheri/CHERI-zephyr/soc/silabs/Kconfig.defconfig"
osource "/home/cheri/CHERI-zephyr/soc/sifive/sifive_freedom/Kconfig.defconfig"
osource "/home/cheri/CHERI-zephyr/soc/sensry/Kconfig.defconfig"
osource "/home/cheri/CHERI-zephyr/soc/rockchip/Kconfig.defconfig"
osource "/home/cheri/CHERI-zephyr/soc/renode/riscv_virtual/Kconfig.defconfig"
osource "/home/cheri/CHERI-zephyr/soc/renode/cortex_r8_virtual/Kconfig.defconfig"
osource "/home/cheri/CHERI-zephyr/soc/renesas/smartbond/Kconfig.defconfig"
osource "/home/cheri/CHERI-zephyr/soc/renesas/rz/Kconfig.defconfig"
osource "/home/cheri/CHERI-zephyr/soc/renesas/rx/Kconfig.defconfig"
osource "/home/cheri/CHERI-zephyr/soc/renesas/rcar/Kconfig.defconfig"
osource "/home/cheri/CHERI-zephyr/soc/renesas/ra/Kconfig.defconfig"
osource "/home/cheri/CHERI-zephyr/soc/realtek/ec/Kconfig.defconfig"
osource "/home/cheri/CHERI-zephyr/soc/raspberrypi/rpi_pico/Kconfig.defconfig"
osource "/home/cheri/CHERI-zephyr/soc/quicklogic/eos_s3/Kconfig.defconfig"
osource "/home/cheri/CHERI-zephyr/soc/qemu/virt_riscv/Kconfig.defconfig"
osource "/home/cheri/CHERI-zephyr/soc/qemu/malta/Kconfig.defconfig"
osource "/home/cheri/CHERI-zephyr/soc/openisa/rv32m1/Kconfig.defconfig"
osource "/home/cheri/CHERI-zephyr/soc/openhwgroup/cva6/Kconfig.defconfig"
osource "/home/cheri/CHERI-zephyr/soc/oct/osd32mp15x/Kconfig.defconfig"
osource "/home/cheri/CHERI-zephyr/soc/nxp/s32/Kconfig.defconfig"
osource "/home/cheri/CHERI-zephyr/soc/nxp/rw/Kconfig.defconfig"
osource "/home/cheri/CHERI-zephyr/soc/nxp/mcx/Kconfig.defconfig"
osource "/home/cheri/CHERI-zephyr/soc/nxp/lpc/Kconfig.defconfig"
osource "/home/cheri/CHERI-zephyr/soc/nxp/layerscape/Kconfig.defconfig"
osource "/home/cheri/CHERI-zephyr/soc/nxp/kinetis/Kconfig.defconfig"
osource "/home/cheri/CHERI-zephyr/soc/nxp/imxrt/Kconfig.defconfig"
osource "/home/cheri/CHERI-zephyr/soc/nxp/imx/Kconfig.defconfig"
osource "/home/cheri/CHERI-zephyr/soc/nuvoton/numicro/Kconfig.defconfig"
osource "/home/cheri/CHERI-zephyr/soc/nuvoton/numaker/Kconfig.defconfig"
osource "/home/cheri/CHERI-zephyr/soc/nuvoton/npcx/Kconfig.defconfig"
osource "/home/cheri/CHERI-zephyr/soc/nuvoton/npcm/Kconfig.defconfig"
osource "/home/cheri/CHERI-zephyr/soc/nordic/Kconfig.defconfig"
osource "/home/cheri/CHERI-zephyr/soc/neorv32/Kconfig.defconfig"
osource "/home/cheri/CHERI-zephyr/soc/native/inf_clock/Kconfig.defconfig"
osource "/home/cheri/CHERI-zephyr/soc/microchip/miv/Kconfig.defconfig"
osource "/home/cheri/CHERI-zephyr/soc/microchip/mec/Kconfig.defconfig"
osource "/home/cheri/CHERI-zephyr/soc/mediatek/mt8xxx/Kconfig.defconfig"
osource "/home/cheri/CHERI-zephyr/soc/lowrisc/opentitan/Kconfig.defconfig"
osource "/home/cheri/CHERI-zephyr/soc/litex/litex_vexriscv/Kconfig.defconfig"
osource "/home/cheri/CHERI-zephyr/soc/ite/ec/Kconfig.defconfig"
osource "/home/cheri/CHERI-zephyr/soc/intel/raptor_lake/Kconfig.defconfig"
osource "/home/cheri/CHERI-zephyr/soc/intel/lakemont/Kconfig.defconfig"
osource "/home/cheri/CHERI-zephyr/soc/intel/intel_socfpga_std/Kconfig.defconfig"
osource "/home/cheri/CHERI-zephyr/soc/intel/intel_socfpga/Kconfig.defconfig"
osource "/home/cheri/CHERI-zephyr/soc/intel/intel_niosv/Kconfig.defconfig"
osource "/home/cheri/CHERI-zephyr/soc/intel/intel_ish/Kconfig.defconfig"
osource "/home/cheri/CHERI-zephyr/soc/intel/intel_adsp/Kconfig.defconfig"
osource "/home/cheri/CHERI-zephyr/soc/intel/elkhart_lake/Kconfig.defconfig"
osource "/home/cheri/CHERI-zephyr/soc/intel/atom/Kconfig.defconfig"
osource "/home/cheri/CHERI-zephyr/soc/intel/apollo_lake/Kconfig.defconfig"
osource "/home/cheri/CHERI-zephyr/soc/intel/alder_lake/Kconfig.defconfig"
osource "/home/cheri/CHERI-zephyr/soc/infineon/cat3/Kconfig.defconfig"
osource "/home/cheri/CHERI-zephyr/soc/infineon/cat1b/Kconfig.defconfig"
osource "/home/cheri/CHERI-zephyr/soc/infineon/cat1a/Kconfig.defconfig"
osource "/home/cheri/CHERI-zephyr/soc/gd/gd32/Kconfig.defconfig"
osource "/home/cheri/CHERI-zephyr/soc/gaisler/leon3/Kconfig.defconfig"
osource "/home/cheri/CHERI-zephyr/soc/gaisler/gr716a/Kconfig.defconfig"
osource "/home/cheri/CHERI-zephyr/soc/espressif/Kconfig.defconfig"
osource "/home/cheri/CHERI-zephyr/soc/ene/kb1200/Kconfig.defconfig"
osource "/home/cheri/CHERI-zephyr/soc/efinix/sapphire/Kconfig.defconfig"
osource "/home/cheri/CHERI-zephyr/soc/cdns/xtensa_sample_controller/Kconfig.defconfig"
osource "/home/cheri/CHERI-zephyr/soc/cdns/sample_controller32/Kconfig.defconfig"
osource "/home/cheri/CHERI-zephyr/soc/cdns/dc233c/Kconfig.defconfig"
osource "/home/cheri/CHERI-zephyr/soc/brcm/bcmvk/Kconfig.defconfig"
osource "/home/cheri/CHERI-zephyr/soc/brcm/bcm2712/Kconfig.defconfig"
osource "/home/cheri/CHERI-zephyr/soc/brcm/bcm2711/Kconfig.defconfig"
osource "/home/cheri/CHERI-zephyr/soc/bflb/Kconfig.defconfig"
osource "/home/cheri/CHERI-zephyr/soc/atmel/sam0/Kconfig.defconfig"
osource "/home/cheri/CHERI-zephyr/soc/atmel/sam/Kconfig.defconfig"
osource "/home/cheri/CHERI-zephyr/soc/aspeed/Kconfig.defconfig"
osource "/home/cheri/CHERI-zephyr/soc/arm/Kconfig.defconfig"
osource "/home/cheri/CHERI-zephyr/soc/arm/beetle/Kconfig.defconfig"
osource "/home/cheri/CHERI-zephyr/soc/antmicro/myra/Kconfig.defconfig"
osource "/home/cheri/CHERI-zephyr/soc/andestech/Kconfig.defconfig"
osource "/home/cheri/CHERI-zephyr/soc/amd/acp_6_0/Kconfig.defconfig"
osource "/home/cheri/CHERI-zephyr/soc/ambiq/Kconfig.defconfig"
osource "/home/cheri/CHERI-zephyr/soc/aesc/Kconfig.defconfig"
osource "/home/cheri/CHERI-zephyr/soc/adi/max32/Kconfig.defconfig"
```
